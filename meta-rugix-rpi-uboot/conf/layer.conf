## meta-rugix-rpi-uboot/conf/layer.conf
```bitbake
BBPATH .= ":${LAYERDIR}"

BBFILES += "${LAYERDIR}/recipes-*/*/*.bb \
            ${LAYERDIR}/recipes-*/*/*.bbappend"

BBFILE_COLLECTIONS += "meta-rugix-rpi-uboot"
BBFILE_PATTERN_meta-rugix-rpi-uboot = "^${LAYERDIR}/"
# We need to overwrite parts of what `meta-raspberrypi` is doing.
BBFILE_PRIORITY_meta-rugix-rpi-uboot = "10"

LAYERDEPENDS_meta-rugix-rpi-uboot = "core meta-rugix-core"
LAYERRECOMMENDS_meta-rugix-rpi-uboot = ""
LAYERSERIES_COMPAT_meta-rugix-rpi-uboot = "wrynose"

WKS_FILE:rpi ?= "sdimage-rugix-rpi-uboot.wks.in"
WKS_FILE_DEPENDS:append:rpi = " rugix-bootstrap-marker"
RUGIX_SLOTS:rpi ?= "system:2"
IMAGE_BOOT_FILES:append:rpi = " rugix-bootstrap;rugix/bootstrap"
IMAGE_INSTALL:append:rpi = "${@bb.utils.contains('DISTRO_FEATURES', 'rugix', ' packagegroup-rugix-bsp', '', d)}"

RPI_USE_U_BOOT = "1"
```
