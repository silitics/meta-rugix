## meta-rugix-test/conf/layer.conf
```bitbake
BBPATH .= ":${LAYERDIR}"

BBFILES += "${LAYERDIR}/recipes-*/*/*.bb \
            ${LAYERDIR}/recipes-*/*/*.bbappend"

BBFILE_COLLECTIONS += "meta-rugix-test"
BBFILE_PATTERN_meta-rugix-test = "^${LAYERDIR}/"
BBFILE_PRIORITY_meta-rugix-test = "6"

LAYERDEPENDS_meta-rugix-test = "core"
LAYERRECOMMENDS_meta-rugix-test = ""
LAYERSERIES_COMPAT_meta-rugix-test = "scarthgap"
```
